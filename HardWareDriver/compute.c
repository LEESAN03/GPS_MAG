#include "stm32f10x.h"
#include "compute.h"
	  
const uint8_t auchCRCHi[] = {
    0x00, 0xC1, 0x81, 0x40, 0x01, 0xC0, 0x80, 0x41, 0x01, 0xC0, 0x80, 0x41,
    0x00, 0xC1, 0x81, 0x40, 0x01, 0xC0, 0x80, 0x41, 0x00, 0xC1, 0x81, 0x40,
    0x00, 0xC1, 0x81, 0x40, 0x01, 0xC0, 0x80, 0x41, 0x01, 0xC0, 0x80, 0x41,
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    0x00, 0xC1, 0x81, 0x40};
// CRC ??????
const uint8_t auchCRCLo[] = {
    0x00, 0xC0, 0xC1, 0x01, 0xC3, 0x03, 0x02, 0xC2, 0xC6, 0x06, 0x07, 0xC7,
    0x05, 0xC5, 0xC4, 0x04, 0xCC, 0x0C, 0x0D, 0xCD, 0x0F, 0xCF, 0xCE, 0x0E,
    0x0A, 0xCA, 0xCB, 0x0B, 0xC9, 0x09, 0x08, 0xC8, 0xD8, 0x18, 0x19, 0xD9,
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    0x41, 0x81, 0x80, 0x40};


void buf2float(float *tfloat, unsigned char *buf)
{
	int i;
	unsigned char * p1 = (unsigned char *)tfloat;
	unsigned char * p3 = buf;
	for(i=0;i<4;i++)
	{
		*p1 = *p3;
		p1++;
		p3++;
	}	
}

void buf2long(long *tfloat, unsigned char *buf)
{
	int i;
	unsigned char * p1 = (unsigned char *)tfloat;
	unsigned char * p3 = buf;
	for(i=0;i<4;i++)
	{
		*p1 = *p3;
		p1++;
		p3++;
	}
}

void buf2int(int *tint, unsigned char *buf)
{
	int i;
	unsigned char * p1 = (unsigned char *)tint;
	unsigned char * p3 = buf;
	for(i=0;i<4;i++)
	{
		*p1 = *p3;
		p1++;
		p3++;
	}
}

void buf2short(short *tshort, unsigned char *buf)
{
	int i;
	unsigned char * p1 = (unsigned char *)tshort;
	unsigned char * p3 = buf;
	for(i=0;i<2;i++)
	{
		*p1 = *p3;
		p1++;
		p3++;
	}
}

void float2buf(unsigned char *buf,float *tfloat)
{
	int i;
	unsigned char * p1 = (unsigned char *)tfloat;
	unsigned char * p3 = buf;
	for(i=0;i<4;i++)
	{
		*p3 = *p1;
		p1++; 
		p3++;
	}
}

void int2buf(unsigned char *buf,int *tint)
{
	int i;
	unsigned char * p1 = (unsigned char *)tint;
	unsigned char * p3 = buf;
	for(i=0;i<4;i++)
	{
		*p3 = *p1;
		p1++;
		p3++;
	}
} 

void short2buf(unsigned char *buf,short *tshort)
{
	int i;
	unsigned char * p1 = (unsigned char *)tshort;
	unsigned char * p3 = buf;
	for(i=0;i<2;i++)
	{
		*p3 = *p1;
		p1++;
		p3++;
	}
}

//int brinv(float a[],int n)  
//{
//	int *is,*js,i,j,k,l,u,v;
//	int temp1[7];
//	int temp2[7];
//	float d,p;
//	is = temp1;
//	js = temp2;
//	for (k=0; k<=n-1; k++)
//	{
//		d=0.0f;
//		for (i=k; i<=n-1; i++)
//			for (j=k; j<=n-1; j++)
//			{
//				l=i*n+j;
//				p=fabs(a[l]);
//				if (p>d) 
//				{
//					d=p;
//					is[k]=i;
//					js[k]=j;
//				}
//			}
//
//			if (d+1.0f==1.0f)
//			{
//				return(0);
//			}
//			if (is[k]!=k)
//			{
//				for (j=0; j<=n-1; j++)
//				{ 
//					u=k*n+j; 
//					v=is[k]*n+j;
//					p=a[u]; 
//					a[u]=a[v]; 
//					a[v]=p;
//				}
//			}
//			if (js[k]!=k)
//				for (i=0; i<=n-1; i++)
//				{ u=i*n+k; v=i*n+js[k];
//			p=a[u]; a[u]=a[v]; a[v]=p;
//			}
//			l=k*n+k;
//			a[l]=1.0f/a[l];
//			for (j=0; j<=n-1; j++)
//				if (j!=k)
//				{ u=k*n+j; a[u]=a[u]*a[l];}
//				for (i=0; i<=n-1; i++)
//					if (i!=k)
//						for (j=0; j<=n-1; j++)
//							if (j!=k)
//							{ u=i*n+j;
//				a[u]=a[u]-a[i*n+k]*a[k*n+j];
//				}
//				for (i=0; i<=n-1; i++)
//					if (i!=k)
//					{ u=i*n+k; a[u]=-a[u]*a[l];}
//	}
//	for (k=n-1; k>=0; k--)
//	{ if (js[k]!=k)
//	for (j=0; j<=n-1; j++)
//	{ u=k*n+j; v=js[k]*n+j;
//	p=a[u]; a[u]=a[v]; a[v]=p;
//	}
//	if (is[k]!=k)
//		for (i=0; i<=n-1; i++)
//		{ u=i*n+k; v=i*n+is[k];
//	p=a[u]; a[u]=a[v]; a[v]=p;
//	}
//	}
//	return(1);
//}
//
//
//int16_t Math_Constrain(int16_t value,int16_t min,int16_t max)
//{
//	if(value > max)
//		value = max;
//	else if(value < min)
//		value = min;
//	return value;
//}

float Math_fConstrain(float value, float min, float max)
{
	if(value > max)
		value = max;
	else if(value < min)
		value = min;
	return value;
} 

int16_t Math_abs(int16_t value)
{
	if((value>0)||(value==0))
		return value;
	return -value;
}

int16_t Math_min(int16_t value1,int16_t value2)
{
	if(value1<value2)return value1;
	return value2;
}

int16_t Math_max(int16_t value1,int16_t value2){
	if(value1>value2)return value1;
	return value2;
}

uint16_t Get_Crc16(uint8_t *puchMsg, uint16_t usDataLen)
{
    uint8_t uchCRCHi = 0xFF; 
    uint8_t uchCRCLo = 0xFF; 
    uint32_t uIndex;        
    while (usDataLen--)   
    {
        //        uIndex=uchCRCHi^*puchMsg++; //??CRC
        //        uchCRCHi=uchCRCLo^auchCRCHi[uIndex];
        //        uchCRCLo=auchCRCLo[uIndex];
        uIndex = uchCRCLo ^ *puchMsg++; //??CRC
        uchCRCLo = uchCRCHi ^ auchCRCHi[uIndex];
        uchCRCHi = auchCRCLo[uIndex];
    }
    return (uchCRCHi << 8 | uchCRCLo);
}

uint8_t Get_Crc8(uint8_t *ptr, uint16_t len)
{
    uint8_t crc;
    uint8_t i;
    crc = 0;
    while (len--)
    {
        crc ^= *ptr++;
        for (i = 0; i < 8; i++)
        {
            if (crc & 0x01)
                crc = (crc >> 1) ^ 0x8C;
            else
                crc >>= 1;
        }
    }
    return crc;
}


uint16_t Checksum_Sum(uint8_t *buf, uint16_t len)
{
    uint8_t check = 0;
    while (len--)
    {
       check += *buf++;
    }
    check = 256 - check % 256;
    return (check)&0x00ff;
}


unsigned int cal_crc16(unsigned char buffer[], unsigned char len)
{
    unsigned char i = 0, j = 0;
    unsigned int crc_register = 0;

    while (len-- != 0)
    {
        for (i = 0x80; i != 0; i = i >> 1)
        {

            if ((crc_register & 0x80000) != 0)
            {
                crc_register <<= 1;
                crc_register ^= 0x1021;
            }
            else
            {
                crc_register <<= 1;
            }

            if ((buffer[j] & i) != 0)
            {
                crc_register ^= 0x1021;
            }
        }

        j++;
    }

    return (crc_register);
}
